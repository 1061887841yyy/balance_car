#include "balance_car/oled_ssd1306.h"

#include "balance_car/i2c_bus.h"
#include <string.h>

#define OLED_CONTROL_CMD   0x00U
#define OLED_CONTROL_DATA  0x40U

static uint8_t s_buffer[OLED_WIDTH * OLED_PAGES];
static uint8_t s_next_page;
static uint8_t s_oled_addr_7bit;
static uint8_t s_probe_mask;
static uint8_t s_fail_step;

static const uint8_t s_font5x7[][5] = {
    {0x00,0x00,0x00,0x00,0x00}, /* space */
    {0x00,0x00,0x5f,0x00,0x00}, /* ! */
    {0x00,0x07,0x00,0x07,0x00}, /* " */
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    {0x10,0x08,0x08,0x10,0x08}, /* ~ */
};

static HAL_StatusTypeDef Oled_WriteCommand(uint8_t command)
{
    uint8_t data[2] = {OLED_CONTROL_CMD, command};
    return HAL_I2C_Master_Transmit(BalanceI2C1_GetHandle(), (uint16_t)s_oled_addr_7bit << 1,
                                   data, sizeof(data), 10U);
}

static HAL_StatusTypeDef Oled_SetPage(uint8_t page)
{
    if (Oled_WriteCommand((uint8_t)(0xB0U | page)) != HAL_OK) {
        return HAL_ERROR;
    }
    if (Oled_WriteCommand(0x00U) != HAL_OK) {
        return HAL_ERROR;
    }
    return Oled_WriteCommand(0x10U);
}

HAL_StatusTypeDef Oled_Init(void)
{
    static const uint8_t init_cmds[] = {
        0xAE, 0x20, 0x02, 0xB0, 0xC8, 0x00, 0x10, 0x40,
        0x81, 0x7F, 0xA1, 0xA6, 0xA8, 0x3F, 0xA4, 0xD3,
        0x00, 0xD5, 0x80, 0xD9, 0xF1, 0xDA, 0x12, 0xDB,
        0x40, 0x8D, 0x14, 0xAF
    };

    s_oled_addr_7bit = 0U;
    s_probe_mask = 0U;
    s_fail_step = 0U;

    if (BalanceI2C1_Init() != HAL_OK) {
        s_fail_step = 1U;
        return HAL_ERROR;
    }

    HAL_Delay(20U);

    if (HAL_I2C_IsDeviceReady(BalanceI2C1_GetHandle(), 0x3CU << 1, 2U, 10U) == HAL_OK) {
        s_probe_mask |= 0x01U;
        s_oled_addr_7bit = 0x3CU;
    }
    if (HAL_I2C_IsDeviceReady(BalanceI2C1_GetHandle(), 0x3DU << 1, 2U, 10U) == HAL_OK) {
        s_probe_mask |= 0x02U;
        if (s_oled_addr_7bit == 0U) {
            s_oled_addr_7bit = 0x3DU;
        }
    }
    if (s_oled_addr_7bit == 0U) {
        s_fail_step = 2U;
        return HAL_ERROR;
    }

    for (uint8_t i = 0U; i < sizeof(init_cmds); i++) {
        if (Oled_WriteCommand(init_cmds[i]) != HAL_OK) {
            s_fail_step = 3U;
            return HAL_ERROR;
        }
    }

    Oled_Clear();
    for (uint8_t page = 0U; page < OLED_PAGES; page++) {
        s_next_page = page;
        if (Oled_RefreshNextPage() != HAL_OK) {
            s_fail_step = 4U;
            return HAL_ERROR;
        }
    }
    s_next_page = 0U;
    return HAL_OK;
}

HAL_StatusTypeDef Oled_RefreshNextPage(void)
{
    uint8_t tx[OLED_WIDTH + 1U];

    if (Oled_SetPage(s_next_page) != HAL_OK) {
        return HAL_ERROR;
    }

    tx[0] = OLED_CONTROL_DATA;
    memcpy(&tx[1], &s_buffer[(uint16_t)s_next_page * OLED_WIDTH], OLED_WIDTH);

    if (HAL_I2C_Master_Transmit(BalanceI2C1_GetHandle(), (uint16_t)s_oled_addr_7bit << 1,
                                tx, sizeof(tx), 20U) != HAL_OK) {
        return HAL_ERROR;
    }

    s_next_page++;
    if (s_next_page >= OLED_PAGES) {
        s_next_page = 0U;
    }
    return HAL_OK;
}

uint8_t Oled_GetAddress7Bit(void)
{
    return s_oled_addr_7bit;
}

uint8_t Oled_GetProbeMask(void)
{
    return s_probe_mask;
}

uint8_t Oled_GetFailStep(void)
{
    return s_fail_step;
}

void Oled_Clear(void)
{
    memset(s_buffer, 0, sizeof(s_buffer));
}

void Oled_WriteString(uint8_t x, uint8_t page, const char *text)
{
    uint16_t index;

    if (page >= OLED_PAGES || x >= OLED_WIDTH || text == 0) {
        return;
    }

    index = (uint16_t)page * OLED_WIDTH + x;
    while (*text != '\0' && x < (OLED_WIDTH - 5U)) {
        char ch = *text++;
        const uint8_t *glyph;

        if (ch < ' ' || ch > '~') {
            ch = '?';
        }
        glyph = s_font5x7[(uint8_t)ch - (uint8_t)' '];

        for (uint8_t col = 0U; col < 5U && x < OLED_WIDTH; col++) {
            s_buffer[index++] = glyph[col];
            x++;
        }
        if (x < OLED_WIDTH) {
            s_buffer[index++] = 0x00U;
            x++;
        }
    }
}
